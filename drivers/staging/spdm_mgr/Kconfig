## drivers/staging/spdm_mgr/Kconfig
```kconfig
# SPDX-License-Identifier: GPL-2.0
#
# SPDM Manager Driver
#
config SPDM_MGR
	bool "SPDM MGR support"
	default y
	help
	  This option adds SPDM manager support. It provides APIs to create
	  SPDM manager and also other helper functions to make SPDM connection
	  with device.
```

## drivers/vfio/pci/intel/idxd/Kconfig
```kconfig
config VFIO_DEVICE_IDXD
	tristate "VFIO device driver for Intel IDXD"
	depends on VFIO && X86_64
	default n
	help
          VFIO based device driver for Intel Accelerator Devices
          (IDXD) driver. Enabling this will make IDXD devices and
          workqueues functional inside a virtual machine. Currently
          only dedicated workqueues are available.

	  If you don't know what to do here, say N.
```
